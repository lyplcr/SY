/*
*********************************************************************************************************
* @file    	date.c
* @author  	SY
* @version 	V1.0.0
* @date    	2016-10-18 18:58:10
* @IDE	 	Keil V5.18.0.0
* @Chip    	STM32F407VE
* @brief   	日期时间源文件
*********************************************************************************************************
* @attention
*
* 
*********************************************************************************************************
*/

/*
*********************************************************************************************************
*                              				Private Includes
*********************************************************************************************************
*/
#include "kernel.h"


/*
*********************************************************************************************************
*                              				Private define
*********************************************************************************************************
*/


/*
*********************************************************************************************************
*                              				Private typedef
*********************************************************************************************************
*/

/*
*********************************************************************************************************
*                              				Private constants
*********************************************************************************************************
*/

/*
*********************************************************************************************************
*                              				Private macro
*********************************************************************************************************
*/

/*
*********************************************************************************************************
*                              				Private variables
*********************************************************************************************************
*/

/*
*********************************************************************************************************
*                              				Private function prototypes
*********************************************************************************************************
*/

/*
*********************************************************************************************************
*                              				Private functions
*********************************************************************************************************
*/
/*
*********************************************************************************************************
* Function Name : ReadSystemTime
* Description	: 读取系统时间
* Input			: None
* Output		: None
* Return		: None
*********************************************************************************************************
*/
void ReadSystemTime(tTime *time)
{
	uint8_t t[3];
	uint8_t temp;
	
	bsp_ReadPCF8563(0x02,t,3); 
	
	temp=t[0]&0x7F;
	time->ucSec=temp&0x0F;
	time->ucSec+=(temp>>4)*10;
	temp=t[1]&0x7F;
	time->ucMin=temp&0x0F;
	time->ucMin+=(temp>>4)*10;
	temp=t[2]&0x3F;
	time->ucHour=temp&0x0F;
	time->ucHour+=(temp>>4)*10;
}
 
/*
*********************************************************************************************************
* Function Name : ReadSystemDate
* Description	: 读取系统日期
* Input			: None
* Output		: None
* Return		: None
*********************************************************************************************************
*/
void ReadSystemDate(tTime *time)
{
	uint8_t t[4];
	uint8_t temp;
	bsp_ReadPCF8563(0x05,t,4); 
	temp=t[0]&0x3F;
	time->ucMday=temp&0x0F;
	time->ucMday+=(temp>>4)*10; 
	time->ucWday=t[1]&0x07;	
	temp=t[2]&0x1F;
	time->ucMon=temp&0x0F;
	time->ucMon+=(temp>>4)*10;

	time->usYear=t[3]&0x0F;
	time->usYear+=(t[3]>>4)*10;
	time->usYear+=2000;
}

/*
*********************************************************************************************************
* Function Name : WriteSystemDateTime
* Description	: 写入系统日期和时间
* Input			: None
* Output		: None
* Return		: None
*********************************************************************************************************
*/
void WriteSystemDateTime(tTime *time)
{
	uint8_t t[7];
	uint8_t sw,gw;
	uint16_t year;
	if(time->ucSec>=60)
	time->ucSec=0;	
	sw=time->ucSec/10;
	gw=time->ucSec%10;
	t[0]=(sw<<4)+gw;
	
	if(time->ucMin>=60)
	time->ucMin=0;
	sw=time->ucMin/10;
	gw=time->ucMin%10;
	t[1]=(sw<<4)+gw;
 
	if(time->ucHour>=24)
	time->ucHour=0;	 
	sw=time->ucHour/10;
	gw=time->ucHour%10;
	t[2]=(sw<<4)+gw;
	
	if(time->ucMday>=32)
	time->ucMday=0;	 
	sw=time->ucMday/10;
	gw=time->ucMday%10;
	t[3]=(sw<<4)+gw;
	
	if(time->ucWday>=7)
	time->ucWday=0;	  
	t[4]=time->ucWday; 
	
	if(time->ucMon>=13)
	time->ucMon=0;	 
	sw=time->ucMon/10;
	gw=time->ucMon%10;
	t[5]=(sw<<4)+gw;
	
	if(time->usYear<2000)
	time->usYear=2000;	
	if(time->usYear>2100)
	time->usYear=2100;	 
	year=(time->usYear)%100; 
	sw=year/10;
	gw=year%10;
	t[6]=(sw<<4)+gw;
	bsp_WritePCF8563(0x02,t,7); 
}


/************************ (C) COPYRIGHT STMicroelectronics **********END OF FILE*************************/
