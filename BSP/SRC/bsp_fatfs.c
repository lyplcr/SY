/*
*********************************************************************************************************
* @file    	bsp_fatfs.c
* @author  	SY
* @version 	V1.0.0
* @date    	2016-10-20 19:41:05
* @IDE	 	Keil V5.18.0.0
* @Chip    	STM32F407VE
* @brief   	文件系统源文件
*********************************************************************************************************
* @attention
*
* 
*********************************************************************************************************
*/

/*
*********************************************************************************************************
*                              				Private Includes
*********************************************************************************************************
*/
#include "bsp.h"
#include "ff_gen_drv.h"
#include "sd_diskio.h"
#include "usbh_diskio.h"
#include "usbh_usr.h"
#include "usbh_hid.h"

/*
*********************************************************************************************************
*                              				Private define
*********************************************************************************************************
*/


/*
*********************************************************************************************************
*                              				Private typedef
*********************************************************************************************************
*/

/*
*********************************************************************************************************
*                              				Private constants
*********************************************************************************************************
*/

/*
*********************************************************************************************************
*                              				Private macro
*********************************************************************************************************
*/

/*
*********************************************************************************************************
*                              				Private variables
*********************************************************************************************************
*/

char SDPath[4]; 
FATFS SDFatFs;

char USBPath[4]; 
FATFS USBFatFs;

/*
*********************************************************************************************************
*                              				Private function prototypes
*********************************************************************************************************
*/

/*
*********************************************************************************************************
*                              				Private functions
*********************************************************************************************************
*/
/*
*********************************************************************************************************
* Function Name : bsp_InitFatFs
* Description	: 初始化FatFs
* Input			: None
* Output		: None
* Return		: None
*********************************************************************************************************
*/
void bsp_InitFatFs( void )
{
	/* 挂载MMC */
	if (FATFS_LinkDriver(&SD_Driver, SDPath) == 0)
	{
		FRESULT res = f_mount(&SDFatFs, (TCHAR const*)SDPath, 0);
		if (res != FR_OK)
		{
			/* FatFs Initialization Error */
			bsp_ErrorHandler();
			
			ECHO(DEBUG_BSP_INIT, "挂载SD卡 .......... ERROR");
		}
		else
		{	
			ECHO(DEBUG_BSP_INIT, "挂载SD卡 .......... OK");
		}
	}
	
	/* 挂载U盘 */
	if (FATFS_LinkDriver(&USBH_Driver, USBPath) == 0)
	{
		/* Init Host Library,Add Supported Class and Start the library*/
		USBH_Init(&hUsbHostHS, USBH_UserProcess, HOST_HS);

		USBH_RegisterClass(&hUsbHostHS, USBH_MSC_CLASS);
	#if 0	
		USBH_RegisterClass(&hUsbHostHS, USBH_HID_CLASS);
	#endif
		
		USBH_Start(&hUsbHostHS);
		
		ECHO(DEBUG_BSP_INIT, "USB初始化 .......... OK");
	}
}

/*
*********************************************************************************************************
* Function Name : bsp_GetSDRootPath
* Description	: 获取SD卡根路径
* Input			: None
* Output		: None
* Return		: None
*********************************************************************************************************
*/
const char *bsp_GetSDRootPath( void )
{
	return SDPath;
}

/*
*********************************************************************************************************
* Function Name : bsp_GetUSBRootPath
* Description	: 获取USB卡根路径
* Input			: None
* Output		: None
* Return		: None
*********************************************************************************************************
*/
const char *bsp_GetUSBRootPath( void )
{
	return USBPath;
}

/************************ (C) COPYRIGHT STMicroelectronics **********END OF FILE*************************/
